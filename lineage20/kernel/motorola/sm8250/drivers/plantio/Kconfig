## lineage20/kernel/motorola/sm8250/drivers/plantio/Kconfig
```kconfig
config PLANTIO
 tristate "Plantio module"
 default m
 depends on MODULES
 help
   Plantio is a test device used in DevTITANS course.
   
```
